## firmware/managed_components/mr9you__rt-tftp/examples/tftp/sdkconfig.defaults
```kconfig
# Enable filesystem
CONFIG_PARTITION_TABLE_CUSTOM=y
CONFIG_PARTITION_TABLE_CUSTOM_FILENAME="partitions_example.csv"
CONFIG_PARTITION_TABLE_FILENAME="partitions_example.csv"

CONFIG_ESPTOOLPY_FLASHSIZE_4MB=y

# On chips with USB serial, disable secondary console which does not make sense when using console component
CONFIG_ESP_CONSOLE_SECONDARY_NONE=y
```
